## onhub-3.14/onhub.its
```
/dts-v1/;

/ {
  description = "Chrome OS kernel image with one or more FDT blobs";
  #address-cells = <1>;
  images {
    kernel@1{
      description = "kernel";
      data = /incbin/("chromeos-3.14/arch/arm/boot/zImage");
      type = "kernel_noload";
      arch = "arm";
      os = "linux";
      compression = "none";
      load = <0>;
      entry = <0>;
    };
    fdt@1{
      description = "qcom-apq8064-ifc6410.dtb";
      data = /incbin/("chromeos-3.14/arch/arm/boot/dts/qcom-apq8064-ifc6410.dtb");
      type = "flat_dt";
      arch = "arm";
      compression = "none";
      hash@1{
	algo = "sha1";
      };
    };
    fdt@2{
      description = "qcom-apq8074-dragonboard.dtb";
      data = /incbin/("chromeos-3.14/arch/arm/boot/dts/qcom-apq8074-dragonboard.dtb");
      type = "flat_dt";
      arch = "arm";
      compression = "none";
      hash@1{
	algo = "sha1";
      };
    };
    fdt@3{
      description = "qcom-apq8084-mtp.dtb";
      data = /incbin/("chromeos-3.14/arch/arm/boot/dts/qcom-apq8084-mtp.dtb");
      type = "flat_dt";
      arch = "arm";
      compression = "none";
      hash@1{
	algo = "sha1";
      };
    };
    fdt@4{
      description = "qcom-ipq8064-ap148.dtb";
      data = /incbin/("chromeos-3.14/arch/arm/boot/dts/qcom-ipq8064-ap148.dtb");
      type = "flat_dt";
      arch = "arm";
      compression = "none";
      hash@1{
	algo = "sha1";
      };
    };
    fdt@5{
      description = "qcom-ipq8064-storm.dtb";
      data = /incbin/("chromeos-3.14/arch/arm/boot/dts/qcom-ipq8064-storm.dtb");
      type = "flat_dt";
      arch = "arm";
      compression = "none";
      hash@1{
	algo = "sha1";
      };
    };
    fdt@6{
      description = "qcom-ipq8064-whirlwind-sp3.dtb";
      data = /incbin/("chromeos-3.14/arch/arm/boot/dts/qcom-ipq8064-whirlwind-sp3.dtb");
      type = "flat_dt";
      arch = "arm";
      compression = "none";
      hash@1{
	algo = "sha1";
      };
    };
    fdt@7{
      description = "qcom-ipq8064-whirlwind-sp5.dtb";
      data = /incbin/("chromeos-3.14/arch/arm/boot/dts/qcom-ipq8064-whirlwind-sp5.dtb");
      type = "flat_dt";
      arch = "arm";
      compression = "none";
      hash@1{
	algo = "sha1";
      };
    };
    fdt@8{
      description = "qcom-msm8660-surf.dtb";
      data = /incbin/("chromeos-3.14/arch/arm/boot/dts/qcom-msm8660-surf.dtb");
      type = "flat_dt";
      arch = "arm";
      compression = "none";
      hash@1{
	algo = "sha1";
      };
    };
    fdt@9{
      description = "qcom-msm8960-cdp.dtb";
      data = /incbin/("chromeos-3.14/arch/arm/boot/dts/qcom-msm8960-cdp.dtb");
      type = "flat_dt";
      arch = "arm";
      compression = "none";
      hash@1{
	algo = "sha1";
      };
    };
  };
  configurations {
    default = "conf@1";
    conf@1{
      kernel = "kernel@1";
      fdt = "fdt@1";
    };
    conf@2{
      kernel = "kernel@1";
      fdt = "fdt@2";
    };
    conf@3{
      kernel = "kernel@1";
      fdt = "fdt@3";
    };
    conf@4{
      kernel = "kernel@1";
      fdt = "fdt@4";
    };
    conf@5{
      kernel = "kernel@1";
      fdt = "fdt@5";
    };
    conf@6{
      kernel = "kernel@1";
      fdt = "fdt@6";
    };
    conf@7{
      kernel = "kernel@1";
      fdt = "fdt@7";
    };
    conf@8{
      kernel = "kernel@1";
      fdt = "fdt@8";
    };
    conf@9{
      kernel = "kernel@1";
      fdt = "fdt@9";
    };
  };
};
```

## untangle-onhub-3.14/onhub.its
```
/dts-v1/;

/ {
  description = "Chrome OS kernel image with one or more FDT blobs";
  #address-cells = <1>;
  images {
    kernel@1{
      description = "kernel";
      data = /incbin/("arch/arm/boot/zImage");
      type = "kernel_noload";
      arch = "arm";
      os = "linux";
      compression = "none";
      load = <0>;
      entry = <0>;
    };
    fdt@1{
      description = "qcom-ipq8064-whirlwind-sp5.dtb";
      data = /incbin/("linux-3.10.49/arch/arm/boot/dts/qcom-ipq8064-whirlwind-sp5.dtb");
      type = "flat_dt";
      arch = "arm";
      compression = "none";
      hash@1{
	algo = "sha1";
      };
    };
  };
  configurations {
    default = "conf@1";
    conf@1{
      kernel = "kernel@1";
      fdt = "fdt@1";
    };
  };
};
```
